## sdkconfig.defaults
```kconfig
# Bluetooth — Classic BR/EDR only, Bluedroid stack
CONFIG_BT_ENABLED=y
CONFIG_BTDM_CTRL_MODE_BR_EDR_ONLY=y
CONFIG_BT_BLUEDROID_ENABLED=y
CONFIG_BT_CLASSIC_ENABLED=y
CONFIG_BT_BLE_ENABLED=n
CONFIG_BT_HID_ENABLED=y
CONFIG_BT_HID_HOST_ENABLED=y

# Logging — WARNING for high-frequency BT data paths (HCI/L2CAP/HID/BTC),
# DEBUG for connection-setup paths (BTM/SDP/GAP)
CONFIG_LOG_MAXIMUM_LEVEL_DEBUG=y
CONFIG_LOG_DEFAULT_LEVEL_INFO=y
CONFIG_BT_LOG_HCI_TRACE_LEVEL_WARNING=y
CONFIG_BT_LOG_BTM_TRACE_LEVEL_DEBUG=y
CONFIG_BT_LOG_L2CAP_TRACE_LEVEL_WARNING=y
CONFIG_BT_LOG_SDP_TRACE_LEVEL_DEBUG=y
CONFIG_BT_LOG_GAP_TRACE_LEVEL_DEBUG=y
CONFIG_BT_LOG_HID_TRACE_LEVEL_WARNING=y
CONFIG_BT_LOG_BTC_TRACE_LEVEL_WARNING=y

# Panic handler — print backtrace + halt (don't reboot, so you can read it)
CONFIG_ESP_SYSTEM_PANIC_PRINT_HALT=y

# Task watchdog — detect stuck tasks, trigger panic with backtrace
CONFIG_ESP_TASK_WDT_EN=y
CONFIG_ESP_TASK_WDT_INIT=y
CONFIG_ESP_TASK_WDT_PANIC=y
CONFIG_ESP_TASK_WDT_TIMEOUT_S=10
CONFIG_ESP_TASK_WDT_CHECK_IDLE_TASK_CPU0=y
CONFIG_ESP_TASK_WDT_CHECK_IDLE_TASK_CPU1=y

# FreeRTOS stack overflow detection (canary method — more thorough)
CONFIG_FREERTOS_CHECK_STACKOVERFLOW_CANARY=y

# Flash
CONFIG_ESPTOOLPY_FLASHSIZE_4MB=y
```
